## examples/porting_assistant/sdkconfig.defaults.esp32c6
```kconfig
#
# ESP32C6-specific
#

CONFIG_MM_RESET_N=0
CONFIG_MM_WAKE=1
CONFIG_MM_BUSY=22
CONFIG_MM_SPI_SCK=19
CONFIG_MM_SPI_MOSI=18
CONFIG_MM_SPI_MISO=20
CONFIG_MM_SPI_CS=21
CONFIG_MM_SPI_IRQ=2
CONFIG_MM_BCF_FILE="bcf_mf08651_us.mbin"
```

## examples/rf-test/sdkconfig.defaults
```kconfig
CONFIG_FREERTOS_HZ=1000

CONFIG_IDF_TARGET="esp32s3"
CONFIG_ESP_CONSOLE_USB_SERIAL_JTAG=y

CONFIG_MBEDTLS_NIST_KW_C=y
```

## examples/rf-test/sdkconfig.defaults.esp32c3
```kconfig
#
# ESP32C3-specific
#

CONFIG_MM_RESET_N=2
CONFIG_MM_WAKE=3
CONFIG_MM_BUSY=6
CONFIG_MM_SPI_SCK=8
CONFIG_MM_SPI_MOSI=10
CONFIG_MM_SPI_MISO=9
CONFIG_MM_SPI_CS=5
CONFIG_MM_SPI_IRQ=4
CONFIG_MM_BCF_FILE="bcf_mf08651_us.mbin"
```

## examples/sta_reboot/sdkconfig.defaults
```kconfig
CONFIG_FREERTOS_HZ=1000

CONFIG_IDF_TARGET="esp32s3"

CONFIG_MBEDTLS_NIST_KW_C=y
```

## examples/transfer_reset/sdkconfig.defaults
```kconfig
CONFIG_LWIP_NETIF_STATUS_CALLBACK=y
CONFIG_LWIP_IPV6_AUTOCONFIG=y
CONFIG_LWIP_IPV6_DHCP6=y

CONFIG_FREERTOS_HZ=1000

CONFIG_IDF_TARGET="esp32s3"

CONFIG_LWIP_IRAM_OPTIMIZATION=y
CONFIG_LWIP_TCP_MSS=1460
CONFIG_LWIP_TCP_SND_BUF_DEFAULT=8760
CONFIG_LWIP_TCP_WND_DEFAULT=14600
CONFIG_LWIP_TCP_RECVMBOX_SIZE=10
CONFIG_LWIP_UDP_RECVMBOX_SIZE=10

CONFIG_PARTITION_TABLE_SINGLE_APP_LARGE=y

CONFIG_MBEDTLS_NIST_KW_C=y
```

## framework/mm_shims/Kconfig
```kconfig
# Copyright 2024 Morse Micro
# SPDX-License-Identifier: Apache-2.0
menu "Morse Micro Shim Configuration"
    config MM_RESET_N
        int "RESET_N pin for MM chip"
        default 3
        help
            Output gpio pin used to control the RESET_N line.

    config MM_WAKE
        int "WAKE pin for MM chip"
        default 8
        help
            Output gpio pin used to control the WAKE line.

    config MM_BUSY
        int "BUSY pin for the MM chip"
        default 9
        help
            Input pin used as a rising edge interrupt.

    config MM_SPI_SCK
        int "SCK pin for MM chip"
        default 12
        help
            SPI clock pin.

    config MM_SPI_MOSI
        int "MOSI pin for MM chip"
        default 11
        help
            SPI master out slave in pin.

    config MM_SPI_MISO
        int "MISO pin for MM chip"
        default 13
        help
            SPI master in slave out pin.

    config MM_SPI_CS
        int "SPI CS pin for MM chip"
        default 10
        help
            SPI chip select pin.

    config MM_SPI_IRQ
        int "SPI IRQ pin for MM chip"
        default 5
        help
            Out of band interupt pin used to indicate that
            the MM chip has data for the host.

    config MM_BCF_FILE
        string "MM Board Configuration File"
        default "bcf_mf08651_us.mbin"
        help
            Set the name of the BCF (Board Configuration File) to use.
            Example valid filenames include:
              - bcf_mf08651_us.mbin
              - bcf_mf08551.mbin
              - bcf_mf08251.mbin
              - bcf_mf03120.mbin

            This file provides board-specific configuration data for the Morse Micro chip/module.

            The build system will search for the specified file in the following locations:
              1. morsefirmware/ in the root of the application being built
              2. framework/morsefirmware/ in the mm-iot-esp32 SDK (defined via the MMIOT_ROOT environment variable)

            If the file is not found in either location, a warning will be reported during
            configuration.

    config MM_FW_FILE
        string "MM Firmware File"
        default "mm6108.mbin"
        help
            This is the firmware file for the Morse Micro chip/module.

            The build system will search for the specified file in the following locations:
              1. morsefirmware/ in the root of the application being built
              2. framework/morsefirmware/ in the mm-iot-esp32 SDK (defined via the MMIOT_ROOT environment variable)

            If the file is not found in either location, a warning will be reported during
            configuration.
endmenu
```
